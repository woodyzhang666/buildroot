## configs/sipeed_lichee_rv_dock_defconfig
```kconfig
BR2_riscv=y
BR2_PACKAGE_GLIBC_KERNEL_COMPAT=y
BR2_PACKAGE_GLIBC_UTILS=y
BR2_TOOLCHAIN_BUILDROOT_CXX=y
BR2_ENABLE_DEBUG=y
BR2_ENABLE_RUNTIME_DEBUG=y
BR2_INIT_SYSTEMD=y
BR2_SYSTEM_BIN_SH_BASH=y
BR2_SYSTEM_DEFAULT_PATH="/bin:/sbin:/usr/bin:/usr/sbin"
BR2_GENERATE_LOCALE="C en_US"
BR2_SYSTEM_ENABLE_NLS=y
BR2_ROOTFS_OVERLAY="board/sipeed/lichee_rv/overlay board/sipeed/lichee_rv_dock/overlay"
BR2_ROOTFS_POST_IMAGE_SCRIPT="support/scripts/genimage.sh"
BR2_ROOTFS_POST_SCRIPT_ARGS="-c board/sipeed/lichee_rv_dock/genimage.cfg"
BR2_LINUX_KERNEL=y
BR2_LINUX_KERNEL_CUSTOM_TARBALL=y
BR2_LINUX_KERNEL_CUSTOM_TARBALL_LOCATION="$(call github,woodyzhang666,linux,7ac91b69d7d7566f8b1fcb6970c625c41db16efb)/linux-7ac91b69d7d7566f8b1fcb6970c625c41db16efb.tar.gz"
BR2_LINUX_KERNEL_DEFCONFIG="nezha"
BR2_LINUX_KERNEL_CONFIG_FRAGMENT_FILES="board/sipeed/lichee_rv_dock/linux.fragment"
BR2_LINUX_KERNEL_DTS_SUPPORT=y
BR2_LINUX_KERNEL_INTREE_DTS_NAME="allwinner/sun20i-d1-lichee-rv-dock"
BR2_LINUX_KERNEL_INSTALL_TARGET=y
# BR2_PACKAGE_BUSYBOX is not set
BR2_PACKAGE_BZIP2=y
BR2_PACKAGE_GZIP=y
BR2_PACKAGE_PIGZ=y
BR2_PACKAGE_UNRAR=y
BR2_PACKAGE_UNZIP=y
BR2_PACKAGE_XZ=y
BR2_PACKAGE_ZIP=y
BR2_PACKAGE_GDB=y
BR2_PACKAGE_GDB_SERVER=y
BR2_PACKAGE_GDB_DEBUGGER=y
BR2_PACKAGE_GDB_TUI=y
BR2_PACKAGE_GDB_PYTHON=y
BR2_PACKAGE_BINUTILS=y
BR2_PACKAGE_BINUTILS_TARGET=y
BR2_PACKAGE_DIFFUTILS=y
BR2_PACKAGE_FINDUTILS=y
BR2_PACKAGE_GAWK=y
BR2_PACKAGE_GETTEXT=y
BR2_PACKAGE_GREP=y
BR2_PACKAGE_LIBTOOL=y
BR2_PACKAGE_MAKE=y
BR2_PACKAGE_PATCH=y
BR2_PACKAGE_PKGCONF=y
BR2_PACKAGE_SED=y
BR2_PACKAGE_TREE=y
BR2_PACKAGE_CIFS_UTILS=y
BR2_PACKAGE_CIFS_UTILS_SMBTOOLS=y
BR2_PACKAGE_CPIO=y
BR2_PACKAGE_DOSFSTOOLS=y
BR2_PACKAGE_DOSFSTOOLS_FATLABEL=y
BR2_PACKAGE_DOSFSTOOLS_FSCK_FAT=y
BR2_PACKAGE_DOSFSTOOLS_MKFS_FAT=y
BR2_PACKAGE_E2FSPROGS=y
BR2_PACKAGE_EXFAT=y
BR2_PACKAGE_EXFAT_UTILS=y
BR2_PACKAGE_EXFATPROGS=y
BR2_PACKAGE_NFS_UTILS=y
BR2_PACKAGE_NFS_UTILS_NFSV4=y
BR2_PACKAGE_NFS_UTILS_GSS=y
BR2_PACKAGE_NTFS_3G=y
BR2_PACKAGE_NTFS_3G_ENCRYPTED=y
BR2_PACKAGE_NTFS_3G_NTFSPROGS=y
BR2_PACKAGE_DBUS_GLIB=y
BR2_PACKAGE_DBUS_PYTHON=y
BR2_PACKAGE_DBUS_TRIGGERD=y
BR2_PACKAGE_MINICOM=y
BR2_PACKAGE_RTL8723DS=y
BR2_PACKAGE_RTL8723DS_BT=y
BR2_PACKAGE_PERL=y
BR2_PACKAGE_PERL_THREADS=y
BR2_PACKAGE_PYTHON_AIOHTTP_CORS=y
BR2_PACKAGE_PYTHON_AIOHTTP_DEBUGTOOLBAR=y
BR2_PACKAGE_PYTHON_AIOHTTP_MAKO=y
BR2_PACKAGE_PYTHON_AIOHTTP_REMOTES=y
BR2_PACKAGE_PYTHON_AIOHTTP_SECURITY=y
BR2_PACKAGE_PYTHON_AIOHTTP_SESSION=y
BR2_PACKAGE_PYTHON_AIOHTTP_SSE=y
BR2_PACKAGE_PYTHON_CHARDET=y
BR2_PACKAGE_PYTHON_KVMD=y
BR2_PACKAGE_PYTHON_PYGMENTS=y
BR2_PACKAGE_PYTHON_PYRAD=y
BR2_PACKAGE_PYTHON_QRCODE=y
BR2_PACKAGE_PYTHON_QRCODE_SVG=y
BR2_PACKAGE_PYTHON_QRCODE_PIL=y
BR2_PACKAGE_LIBZIP=y
BR2_PACKAGE_LZ4=y
BR2_PACKAGE_LZ4_PROGS=y
BR2_PACKAGE_CA_CERTIFICATES=y
BR2_PACKAGE_GNUTLS_OPENSSL=y
BR2_PACKAGE_GNUTLS_TOOLS=y
BR2_PACKAGE_GNUTLS_ENABLE_SSL2=y
BR2_PACKAGE_GNUTLS_ENABLE_GOST=y
BR2_PACKAGE_LIBSECRET=y
BR2_PACKAGE_LIBSSH=y
BR2_PACKAGE_LIBSSH_SERVER=y
BR2_PACKAGE_LIBSSH_OPENSSL=y
BR2_PACKAGE_LIBSSH2=y
BR2_PACKAGE_LIBSSH2_OPENSSL=y
BR2_PACKAGE_LIBOPENSSL_BIN=y
BR2_PACKAGE_LIBOPENSSL_ENGINES=y
BR2_PACKAGE_LIBSYSFS=y
BR2_PACKAGE_LIBFTDI=y
BR2_PACKAGE_LIBFTDI1=y
BR2_PACKAGE_LIBFTDI1_PYTHON_BINDINGS=y
BR2_PACKAGE_LIBGPIOD_TOOLS=y
BR2_PACKAGE_LIBHID=y
BR2_PACKAGE_LIBSERIAL=y
BR2_PACKAGE_LIBSERIALPORT=y
BR2_PACKAGE_LIBV4L=y
BR2_PACKAGE_LIBJSON=y
BR2_PACKAGE_LIBMPEG2=y
BR2_PACKAGE_LIBMPEG2_BINS=y
BR2_PACKAGE_LIBCURL=y
BR2_PACKAGE_LIBCURL_CURL=y
BR2_PACKAGE_LIBWEBSOCK=y
BR2_PACKAGE_LIBWEBSOCKETS=y
BR2_PACKAGE_LIBBSD=y
BR2_PACKAGE_BC=y
BR2_PACKAGE_BLUEZ5_UTILS=y
BR2_PACKAGE_BLUEZ5_UTILS_CLIENT=y
BR2_PACKAGE_ETHTOOL=y
BR2_PACKAGE_IFTOP=y
BR2_PACKAGE_IPERF3=y
BR2_PACKAGE_IPUTILS=y
BR2_PACKAGE_NGINX_FILE_AIO=y
BR2_PACKAGE_NGINX_THREADS=y
BR2_PACKAGE_NGINX_HTTP_CACHE=y
BR2_PACKAGE_NGINX_HTTP_SSL_MODULE=y
BR2_PACKAGE_NGINX_HTTP_V2_MODULE=y
BR2_PACKAGE_NGINX_HTTP_REALIP_MODULE=y
BR2_PACKAGE_NGINX_HTTP_ADDITION_MODULE=y
BR2_PACKAGE_NGINX_HTTP_XSLT_MODULE=y
BR2_PACKAGE_NGINX_HTTP_IMAGE_FILTER_MODULE=y
BR2_PACKAGE_NGINX_HTTP_GEOIP_MODULE=y
BR2_PACKAGE_NGINX_HTTP_SUB_MODULE=y
BR2_PACKAGE_NGINX_HTTP_DAV_MODULE=y
BR2_PACKAGE_NGINX_HTTP_FLV_MODULE=y
BR2_PACKAGE_NGINX_HTTP_MP4_MODULE=y
BR2_PACKAGE_NGINX_HTTP_GUNZIP_MODULE=y
BR2_PACKAGE_NGINX_HTTP_GZIP_STATIC_MODULE=y
BR2_PACKAGE_NGINX_HTTP_AUTH_REQUEST_MODULE=y
BR2_PACKAGE_NGINX_HTTP_RANDOM_INDEX_MODULE=y
BR2_PACKAGE_NGINX_HTTP_SECURE_LINK_MODULE=y
BR2_PACKAGE_NGINX_HTTP_DEGRADATION_MODULE=y
BR2_PACKAGE_NGINX_HTTP_SLICE_MODULE=y
BR2_PACKAGE_NGINX_HTTP_STUB_STATUS_MODULE=y
BR2_PACKAGE_NGINX_STREAM=y
BR2_PACKAGE_NGINX_STREAM_REALIP_MODULE=y
BR2_PACKAGE_NGINX_STREAM_SSL_MODULE=y
BR2_PACKAGE_NGINX_STREAM_GEOIP_MODULE=y
BR2_PACKAGE_NGINX_STREAM_SSL_PREREAD_MODULE=y
BR2_PACKAGE_NGINX_SELECT_MODULE=y
BR2_PACKAGE_NGINX_POLL_MODULE=y
BR2_PACKAGE_OPENSSH=y
BR2_PACKAGE_SOCAT=y
BR2_PACKAGE_WGET=y
BR2_PACKAGE_WPA_SUPPLICANT=y
BR2_PACKAGE_WPA_SUPPLICANT_AUTOSCAN=y
BR2_PACKAGE_DASH=y
BR2_PACKAGE_AT=y
BR2_PACKAGE_BASH_COMPLETION=y
BR2_PACKAGE_DIALOG=y
BR2_PACKAGE_FILE=y
BR2_PACKAGE_GNUPG=y
BR2_PACKAGE_GNUPG_AES=y
BR2_PACKAGE_GNUPG_RSA=y
BR2_PACKAGE_GNUPG_GPGV=y
BR2_PACKAGE_GNUPG_GPGSPLIT=y
BR2_PACKAGE_LOGROTATE=y
BR2_PACKAGE_NEOFETCH=y
BR2_PACKAGE_SCREEN=y
BR2_PACKAGE_SUDO=y
BR2_PACKAGE_TIME=y
BR2_PACKAGE_WHICH=y
BR2_PACKAGE_ACL=y
BR2_PACKAGE_COREUTILS=y
BR2_PACKAGE_COREUTILS_INDIVIDUAL_BINARIES=y
BR2_PACKAGE_HTOP=y
BR2_PACKAGE_SYSTEMD_LOCALED=y
BR2_PACKAGE_SYSTEMD_SYSUSERS=y
BR2_PACKAGE_TAR=y
BR2_PACKAGE_VIM=y
BR2_TARGET_ROOTFS_EXT2=y
BR2_TARGET_ROOTFS_EXT2_4=y
BR2_TARGET_ROOTFS_EXT2_SIZE="400M"
# BR2_TARGET_ROOTFS_TAR is not set
BR2_TARGET_OPENSBI=y
BR2_TARGET_OPENSBI_CUSTOM_VERSION=y
BR2_TARGET_OPENSBI_CUSTOM_VERSION_VALUE="1.2"
BR2_TARGET_OPENSBI_PLAT="generic"
# BR2_TARGET_OPENSBI_INSTALL_JUMP_IMG is not set
BR2_TARGET_UBOOT=y
BR2_TARGET_UBOOT_BUILD_SYSTEM_KCONFIG=y
BR2_TARGET_UBOOT_CUSTOM_TARBALL=y
BR2_TARGET_UBOOT_CUSTOM_TARBALL_LOCATION="$(call github,woodyzhang666,u-boot,1ec560da7bdaaefcf3471e1c70bccd5e2f41c71e)/uboot-1ec560da7bdaaefcf3471e1c70bccd5e2f41c71e.tar.gz"
BR2_TARGET_UBOOT_BOARD_DEFCONFIG="lichee_rv_dock"
BR2_TARGET_UBOOT_NEEDS_DTC=y
BR2_TARGET_UBOOT_NEEDS_PYLIBFDT=y
BR2_TARGET_UBOOT_NEEDS_OPENSSL=y
BR2_TARGET_UBOOT_NEEDS_OPENSBI=y
# BR2_TARGET_UBOOT_FORMAT_BIN is not set
BR2_TARGET_UBOOT_FORMAT_CUSTOM=y
BR2_TARGET_UBOOT_FORMAT_CUSTOM_NAME="u-boot-sunxi-with-spl.bin"
BR2_PACKAGE_HOST_GENIMAGE=y
BR2_PACKAGE_HOST_PYTHON_CYTHON=y
BR2_PACKAGE_HOST_PYTHON_GREENLET=y
BR2_PACKAGE_HOST_PYTHON_LXML=y
BR2_PACKAGE_HOST_PYTHON_PYYAML=y
BR2_PACKAGE_HOST_PYTHON_SIX=y
BR2_PACKAGE_HOST_PYTHON_XLRD=y
BR2_PACKAGE_HOST_PYTHON3=y
BR2_PACKAGE_HOST_PYTHON3_BZIP2=y
BR2_PACKAGE_HOST_PYTHON3_SSL=y
```

## package/python-hidapi/Config.in
```kconfig
config BR2_PACKAGE_PYTHON_HIDAPI
	bool "python-hidapi"
	select BR2_PACKAGE_PYTHON_PIP
	select BR2_PACKAGE_HIDAPI
	help
	  A Cython interface to HIDAPI library.

	  https://github.com/trezor/cython-hidapi
```

## package/python-kvmd/Config.in
```kconfig
config BR2_PACKAGE_PYTHON_KVMD
	bool "python-kvmd"
	select BR2_PACKAGE_PYTHON_SETUPTOOLS
	select BR2_PACKAGE_PYTHON_PIP
#	select BR2_PACKAGE_PYTHON_TOX
	select BR2_PACKAGE_PYTHON_MAKO
	select BR2_PACKAGE_PYTHON_PYYAML
	select BR2_PACKAGE_PYTHON_AIOHTTP
	select BR2_PACKAGE_PYTHON_AIOFILES
	select BR2_PACKAGE_PYTHON_PASSLIB
	select BR2_PACKAGE_PYTHON_PERIPHERY
	select BR2_PACKAGE_PYTHON_SERIAL
	select BR2_PACKAGE_PYTHON_SERIAL_ASYNCIO
	select BR2_PACKAGE_PYTHON_SPIDEV
	select BR2_PACKAGE_PYTHON_SETPROCTITLE
	select BR2_PACKAGE_PYTHON_PSUTIL
	select BR2_PACKAGE_PYTHON_NETIFACES
	select BR2_PACKAGE_PYTHON_DBUS_NEXT
#	select BR2_PACKAGE_PYTHON_PAM
	select BR2_PACKAGE_PYTHON_PILLOW
	select BR2_PACKAGE_PYTHON_XLIB
	select BR2_PACKAGE_PYTHON_HIDAPI
	select BR2_PACKAGE_PYTHON_ZSTANDARD
	select BR2_PACKAGE_LIBGPIOD
	select BR2_PACKAGE_FREETYPE
	select BR2_PACKAGE_LIBV4L_UTILS
	select BR2_PACKAGE_NGINX
	select BR2_PACKAGE_OPENSSL
	select BR2_PACKAGE_LIBOPENSSL
	select BR2_PACKAGE_IPTABLES
	select BR2_PACKAGE_IPROUTE2
	select BR2_PACKAGE_DNSMASQ
	select BR2_PACKAGE_USTREAMER
	select BR2_PACKAGE_PYTHON_SYSTEMD
	select BR2_PACKAGE_ZSTD
	select BR2_PACKAGE_DOS2UNIX
	help
	  KVM Daemon for PIKVM.

	  https://pikvm.org/
```

## package/python-pam/Config.in
```kconfig
config BR2_PACKAGE_PYTHON_PAM
	bool "python-pam"
	help
	  Pure Python interface to the Pluggable Authentication Modules
	  system on Linux
	  
	  https://github.com/FirefighterBlu3/python-pam
```

## package/python-pyghmi/Config.in
```kconfig
config BR2_PACKAGE_PYTHON_PYGHMI
	bool "python-pyghmi"
	help
	  This is a pure python implementation of IPMI protocol.

	  pyghmicons and pyghmiutil are example scripts to show how one
	  may incorporate this library into python code

	  https://opendev.org/x/pyghmi
```

## package/python-pyrad/Config.in
```kconfig
config BR2_PACKAGE_PYTHON_PYRAD
	bool "python-pyrad"
	help
	  pyrad is an implementation of a RADIUS client/server as
	  described in RFC2865. It takes care of all the details like
	  building RADIUS packets, sending them and decoding responses.

	  https://github.com/pyradius/pyrad
```

## package/python-pyserial/Config.in
```kconfig
config BR2_PACKAGE_PYTHON_PYSERIAL
	bool "python-pyserial"
	#select BR2_PACKAGE_PYTHON_HIDAPI # runtime
	help
	  Python Serial Port Extension for Win32, OSX, Linux, BSD, Jython,
	  IronPython

	  https://github.com/pyserial/pyserial
```

## package/python-tox/Config.in
```kconfig
config BR2_PACKAGE_PYTHON_TOX
	bool "python-tox"
	help
	  Command line driven CI frontend and development task automation tool.

	  https://tox.readthedocs.io
```

## package/python-zstandard/Config.in
```kconfig
config BR2_PACKAGE_PYTHON_ZSTANDARD
	bool "python-zstandard"
	select BR2_PACKAGE_PYTHON_CFFI
	help
	  This project provides Python bindings for interfacing with the
	  Zstandard compression library. A C extension and CFFI interface
	  are provided.

	  https://github.com/indygreg/python-zstandard
```

## package/ustreamer/Config.in
```kconfig
config BR2_PACKAGE_USTREAMER
	bool "ustreamer"
	depends on BR2_PACKAGE_LIBBSD
	depends on BR2_PACKAGE_LIBEVENT
	depends on BR2_PACKAGE_JPEG
	#depends on BR2_PACKAGE_JPEG_TURBO #try turbo later
	help
	  µStreamer - Lightweight and fast MJPEG-HTTP streamer 

	  https://github.com/pikvm/ustreamer
```
